## CMakeLists.txt
```
# SPDX-License-Identifier: Apache-2.0
cmake_minimum_required(VERSION 3.20.0)
find_package(Zephyr REQUIRED HINTS $ENV{ZEPHYR_BASE})
project(@SAMPLE@)

target_sources(app PRIVATE src/main.c)
```

## sample.yaml
```
sample:
  name: @SAMPLE@
tests:
  sample.@SAMPLE@:
    platform_allow:
      - @BOARD@
    tags: introduction
    harness: console
    harness_config:
      type: one_line
      regex:
        - "@SAMPLE@ up on @BOARD@"
```

## prj.conf
```kconfig
CONFIG_LOG=y
CONFIG_LOG_MODE_IMMEDIATE=y
# virt==phys for direct PL page access; add CONFIG_MAX_XLAT_TABLES if you map many.
CONFIG_KERNEL_DIRECT_MAP=y
```

## boards/BOARD.overlay
```dts
/*
 * Datapath devicetree for @SAMPLE@ on @BOARD@.
 * Empty on purpose: hello-world needs no PL nodes. Add your SPI/JESD204/DMA/GPIO
 * nodes here as you bring the design up (this file is renamed to @BOARD@.overlay).
 */
```

## src/main.c
```c
/*
 * @SAMPLE@ -- zfpga hello-world scaffold for @BOARD@.
 * Confirms Zephyr boots on the PS with the PL bitstream loaded. Add your
 * datapath bring-up (SPI/JESD204/DMA) from here.
 */
#include <zephyr/kernel.h>
#include <zephyr/logging/log.h>

LOG_MODULE_REGISTER(@SAMPLE@, LOG_LEVEL_INF);

int main(void)
{
	LOG_INF("@SAMPLE@ up on @BOARD@");
	return 0;
}
```
